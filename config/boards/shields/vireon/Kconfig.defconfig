## config/boards/shields/vireon/Kconfig.defconfig
```kconfig
if VIREON_LEFT

config ZMK_KEYBOARD_NAME
    default "vireon"

config ZMK_SPLIT_ROLE_CENTRAL
    default y

endif

if VIREON_LEFT || VIREON_RIGHT

config ZMK_SPLIT
    default y

endif

if ZMK_DISPLAY

config I2C
    default y

config SSD1306
    default y

endif # ZMK_DISPLAY
```

## config/boards/shields/vireon/Kconfig.shield
```kconfig
config VIREON_LEFT
    def_bool $(shields_list_contains,vireon_left)

config VIREON_RIGHT
    def_bool $(shields_list_contains,vireon_right)
```
